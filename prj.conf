## CMakeLists.txt
```
cmake_minimum_required(VERSION 3.20.0)
find_package(Zephyr REQUIRED HINTS $ENV{ZEPHYR_BASE})
project(ZPHR-STM32-0003)

target_include_directories(app PRIVATE ${CMAKE_SOURCE_DIR}/inc)

target_sources(app  PRIVATE
               src/main.c
               src/setup_database.c
               src/slave_modbus.c
               src/app_ext_flash.c
               src/app_icon.c
               src/app_sdram.c
               src/app_version.c
               src/buzzer_lib.c
               src/eeprom_lib.c
               src/isotp_conn.c
               src/lcd_lib.c
               src/leds_lib.c
               src/rtc_lib.c
               src/eth_lib.c
               src/sdcard_lib.c
)

add_subdirectory(common/utils)
add_subdirectory(common/string_format)
add_subdirectory(common/mask_format)
add_subdirectory(libraries/alarm)
add_subdirectory(libraries/database)
add_subdirectory(libraries/leds)
add_subdirectory(libraries/ringtone)
add_subdirectory(libraries/modbus_slave)
add_subdirectory(libraries/digital_input)
add_subdirectory(libraries/digital_output)

if(CONFIG_CODE_DATA_RELOCATION)
zephyr_code_relocate(FILES src/app_ext_flash.c LOCATION EXTMEM NOCOPY)
endif()

zephyr_linker_sources(SECTIONS linker/dc_ram.ld)

# ========================
# LVGL Configuration - Simplified for v4.1.0
# ========================

set(LVGL_DIR ${ZEPHYR_LVGL_MODULE_DIR})

target_include_directories(app PRIVATE
    ${LVGL_DIR}/demos/
)

target_sources_ifdef(CONFIG_LV_USE_DEMO_BENCHMARK app PRIVATE
    ${LVGL_DIR}/demos/benchmark/assets/img_benchmark_avatar.c
    ${LVGL_DIR}/demos/benchmark/assets/img_benchmark_lvgl_logo_argb.c
    ${LVGL_DIR}/demos/benchmark/assets/img_benchmark_lvgl_logo_rgb.c
    ${LVGL_DIR}/demos/benchmark/assets/lv_font_benchmark_montserrat_12_compr_az.c.c
    ${LVGL_DIR}/demos/benchmark/assets/lv_font_benchmark_montserrat_16_compr_az.c.c
    ${LVGL_DIR}/demos/benchmark/assets/lv_font_benchmark_montserrat_28_compr_az.c.c
    ${LVGL_DIR}/demos/benchmark/lv_demo_benchmark.c
)

target_sources_ifdef(CONFIG_LV_USE_DEMO_STRESS app PRIVATE
    ${LVGL_DIR}/demos/stress/lv_demo_stress.c
)

# Widgets demo - only if explicitly enabled and assets exist
target_sources_ifdef(CONFIG_LV_USE_DEMO_WIDGETS app PRIVATE
    ${LVGL_DIR}/demos/widgets/assets/img_clothes.c
    ${LVGL_DIR}/demos/widgets/assets/img_demo_widgets_avatar.c
    ${LVGL_DIR}/demos/widgets/assets/img_demo_widgets_needle.c
    ${LVGL_DIR}/demos/widgets/assets/img_lvgl_logo.c
    ${LVGL_DIR}/demos/widgets/lv_demo_widgets.c
)


target_sources_ifdef(CONFIG_LV_USE_DEMO_MUSIC app PRIVATE
    ${LVGL_DIR}/demos/music/lv_demo_music_list.c
    ${LVGL_DIR}/demos/music/lv_demo_music.c
    ${LVGL_DIR}/demos/music/lv_demo_music_main.c
    ${LVGL_DIR}/demos/music/assets/img_lv_demo_music_btn_next.c
    ${LVGL_DIR}/demos/music/assets/img_lv_demo_music_wave_top_large.c
    ${LVGL_DIR}/demos/music/assets/img_lv_demo_music_icon_4_large.c
    ${LVGL_DIR}/demos/music/assets/img_lv_demo_music_icon_4.c
    ${LVGL_DIR}/demos/music/assets/img_lv_demo_music_corner_right.c
    ${LVGL_DIR}/demos/music/assets/img_lv_demo_music_cover_1.c
    ${LVGL_DIR}/demos/music/assets/img_lv_demo_music_slider_knob_large.c
    ${LVGL_DIR}/demos/music/assets/img_lv_demo_music_icon_3.c
    ${LVGL_DIR}/demos/music/assets/img_lv_demo_music_btn_pause.c
    ${LVGL_DIR}/demos/music/assets/img_lv_demo_music_btn_pause_large.c
    ${LVGL_DIR}/demos/music/assets/img_lv_demo_music_wave_bottom_large.c
    ${LVGL_DIR}/demos/music/assets/img_lv_demo_music_icon_2_large.c
    ${LVGL_DIR}/demos/music/assets/img_lv_demo_music_btn_list_play_large.c
    ${LVGL_DIR}/demos/music/assets/img_lv_demo_music_wave_top.c
    ${LVGL_DIR}/demos/music/assets/img_lv_demo_music_btn_play_large.c
    ${LVGL_DIR}/demos/music/assets/img_lv_demo_music_cover_1_large.c
    ${LVGL_DIR}/demos/music/assets/img_lv_demo_music_wave_bottom.c
    ${LVGL_DIR}/demos/music/assets/img_lv_demo_music_corner_left_large.c
    ${LVGL_DIR}/demos/music/assets/img_lv_demo_music_btn_play.c
    ${LVGL_DIR}/demos/music/assets/img_lv_demo_music_list_border.c
    ${LVGL_DIR}/demos/music/assets/img_lv_demo_music_icon_2.c
    ${LVGL_DIR}/demos/music/assets/img_lv_demo_music_btn_next_large.c
    ${LVGL_DIR}/demos/music/assets/img_lv_demo_music_btn_list_play.c
    ${LVGL_DIR}/demos/music/assets/img_lv_demo_music_list_border_large.c
    ${LVGL_DIR}/demos/music/assets/img_lv_demo_music_btn_rnd.c
    ${LVGL_DIR}/demos/music/assets/img_lv_demo_music_cover_3.c
    ${LVGL_DIR}/demos/music/assets/img_lv_demo_music_btn_prev_large.c
    ${LVGL_DIR}/demos/music/assets/img_lv_demo_music_btn_loop.c
    ${LVGL_DIR}/demos/music/assets/img_lv_demo_music_icon_1.c
    ${LVGL_DIR}/demos/music/assets/img_lv_demo_music_slider_knob.c
    ${LVGL_DIR}/demos/music/assets/img_lv_demo_music_corner_right_large.c
    ${LVGL_DIR}/demos/music/assets/img_lv_demo_music_btn_corner_large.c
    ${LVGL_DIR}/demos/music/assets/img_lv_demo_music_corner_left.c
    ${LVGL_DIR}/demos/music/assets/img_lv_demo_music_cover_2_large.c
    ${LVGL_DIR}/demos/music/assets/img_lv_demo_music_icon_3_large.c
    ${LVGL_DIR}/demos/music/assets/img_lv_demo_music_icon_1_large.c
    ${LVGL_DIR}/demos/music/assets/img_lv_demo_music_cover_2.c
    ${LVGL_DIR}/demos/music/assets/img_lv_demo_music_btn_prev.c
    ${LVGL_DIR}/demos/music/assets/img_lv_demo_music_btn_rnd_large.c
    ${LVGL_DIR}/demos/music/assets/img_lv_demo_music_btn_list_pause_large.c
    ${LVGL_DIR}/demos/music/assets/img_lv_demo_music_cover_3_large.c
    ${LVGL_DIR}/demos/music/assets/img_lv_demo_music_btn_list_pause.c
    ${LVGL_DIR}/demos/music/assets/img_lv_demo_music_logo.c
    ${LVGL_DIR}/demos/music/assets/img_lv_demo_music_btn_loop_large.c
)
```

## Kconfig
```
#
# Zephyr configuration options
# Source the Kconfig.zephyr in the Zephyr root directory.
# Check out the docs: https://docs.zephyrproject.org/latest/develop/application/index.html#application-cmakelists-txt
#
menu "Witte-Tecnology"
config MQTT_SERVICE_SERVER_DOMAIN_NAME
	string "MQTT broker domain name"
	default "localhost"
	help
		MQTT server (broker) domain name.
endmenu

menu "Zephyr Kernel"
source "Kconfig.zephyr"
endmenu
```

## west.yml
```
manifest:
  remotes:
    - name: zephyr-base
      url-base: https://github.com/zephyrproject-rtos
    - name: my-company-remote
      url-base: git@github.com:uLipe

  projects:
    - name: zephyr
      remote: zephyr-base
      revision: main
    - name: LinumDevBoardModule
      remote: my-company-remote
      revision: main
      path: my-company-modules/LinumDevBoardModule
```

## prj.conf
```kconfig
CONFIG_MAIN_STACK_SIZE=16384
CONFIG_SYSTEM_WORKQUEUE_STACK_SIZE=2048
CONFIG_PRINTK=y

CONFIG_SPI=y
CONFIG_PWM=y
CONFIG_I2C=y
CONFIG_GPIO=y
CONFIG_RTC=y
CONFIG_RTC_ALARM=y
CONFIG_INPUT=y
CONFIG_EEPROM=y
CONFIG_SERIAL=y
CONFIG_SENSOR=y
CONFIG_DISPLAY=y
CONFIG_CRC=y
CONFIG_FPU=y
CONFIG_CACHE_MANAGEMENT=y
CONFIG_DCACHE=y
CONFIG_ICACHE=y
CONFIG_ARM_MPU=y
CONFIG_HWINFO=y

CONFIG_MODBUS=y
CONFIG_MODBUS_ROLE_CLIENT_SERVER=y

CONFIG_CAN=y
CONFIG_CAN_FD_MODE=y
CONFIG_ISOTP=y
CONFIG_ISOTP_USE_TX_BUF=y
CONFIG_ISOTP_TX_BUF_COUNT=20
CONFIG_ISOTP_BUF_TX_DATA_POOL_SIZE=128
CONFIG_ISOTP_RX_BUF_COUNT=20
CONFIG_ISOTP_RX_BUF_SIZE=128
CONFIG_ISOTP_ENABLE_TX_PADDING=y

CONFIG_FLASH=y
CONFIG_FLASH_MAP=y
CONFIG_FLASH_PAGE_LAYOUT=y
CONFIG_FILE_SYSTEM=y
CONFIG_FILE_SYSTEM_LITTLEFS=y

# Enable binary descriptors
CONFIG_BINDESC=y
CONFIG_BINDESC_DEFINE=y
CONFIG_BINDESC_DEFINE_BUILD_TIME=y
CONFIG_BINDESC_BUILD_DATE_TIME_STRING=y
CONFIG_BINDESC_DEFINE_VERSION=y
CONFIG_BINDESC_KERNEL_VERSION_STRING=y
CONFIG_BINDESC_KERNEL_VERSION_MAJOR=y
CONFIG_BINDESC_APP_VERSION_STRING=y
CONFIG_BINDESC_APP_VERSION_MAJOR=y
CONFIG_BINDESC_APP_VERSION_MINOR=y
CONFIG_BINDESC_APP_VERSION_PATCHLEVEL=y

# === Enable ext sdram ====
CONFIG_MEMC=y

# === Extern Flash ===
# CONFIG_STM32_MEMMAP=y
# CONFIG_CODE_DATA_RELOCATION=y
# CONFIG_HAVE_CUSTOM_LINKER_SCRIPT=y
# CONFIG_CUSTOM_LINKER_SCRIPT="linker/linker_arm_nocopy.ld"
# CONFIG_XIP=y

# ========== LVGL - Configuração otimizada para memória ===============

CONFIG_LVGL=y

# Configurações de memória baseadas no lv_conf.h
# Usar menos memória na RAM interna - baseado no exemplo que usa 240KB
CONFIG_LV_Z_MEM_POOL_SIZE=3000000
CONFIG_LV_Z_MEMORY_POOL_CUSTOM_SECTION=y

# VDB (Video Display Buffer) configuration - otimizado
CONFIG_LV_Z_VDB_CUSTOM_SECTION=y
CONFIG_LV_Z_DOUBLE_VDB=y
CONFIG_LV_Z_FLUSH_THREAD=y
# CONFIG_LV_Z_VDB_SIZE=64

# Usar buffer de desenho menor - baseado no exemplo
# CONFIG_LV_Z_DRAW_BUF_SIZE=24576

# Habilitar sistema de monitoramento
CONFIG_LV_USE_SYSMON=y

# Configurações de log reduzidas
CONFIG_LV_USE_LOG=y

# Fontes mínimas necessárias
CONFIG_LV_FONT_MONTSERRAT_12=y
CONFIG_LV_FONT_MONTSERRAT_14=y
CONFIG_LV_FONT_MONTSERRAT_16=y

# Widgets essenciais apenas
CONFIG_LV_USE_ARC=y
CONFIG_LV_USE_BAR=y
CONFIG_LV_USE_BUTTON=y
CONFIG_LV_USE_LABEL=y
CONFIG_LV_USE_LED=y
CONFIG_LV_USE_SWITCH=y

# Desabilitar widgets que consomem muita memória
CONFIG_LV_USE_ANIMIMG=y
CONFIG_LV_USE_CANVAS=y
CONFIG_LV_USE_CHART=y
CONFIG_LV_USE_CHECKBOX=y
CONFIG_LV_USE_DROPDOWN=y
CONFIG_LV_USE_LINE=y
CONFIG_LV_USE_SPINBOX=y
CONFIG_LV_USE_SPINNER=y
CONFIG_LV_USE_TABLE=y
CONFIG_LV_USE_TABVIEW=y
CONFIG_LV_USE_TILEVIEW=y
CONFIG_LV_USE_WIN=y

CONFIG_INPUT_QUEUE_MAX_MSGS=1024
# Desabilitar todas as demos inicialmente
CONFIG_LV_USE_DEMO_WIDGETS=y
# CONFIG_LV_USE_DEMO_BENCHMARK=y
# CONFIG_LV_USE_DEMO_STRESS=y
# CONFIG_LV_USE_DROPDOWN=y

# Tema simples apenas
CONFIG_LV_USE_THEME_DEFAULT=y
CONFIG_LV_USE_THEME_SIMPLE=n
CONFIG_LV_USE_THEME_MONO=n

CONFIG_LV_USE_MEM_MONITOR=y
CONFIG_LV_USE_PERF_MONITOR=y
CONFIG_LV_PERF_MONITOR_ALIGN_TOP_RIGHT=y
CONFIG_LV_MEM_MONITOR_ALIGN_BOTTOM_LEFT=y
CONFIG_LV_USE_DRAW_DMA2D=y
CONFIG_LV_ATTRIBUTE_MEM_ALIGN_SIZE=64

# ========== Ethernet - Reduzido ===============

CONFIG_NETWORKING=y
CONFIG_NET_SOCKETS=y
CONFIG_NET_IPV4=y
CONFIG_NET_DHCPV4=y

# Buffers de rede reduzidos para economizar RAM
CONFIG_NET_BUF_RX_COUNT=8
CONFIG_NET_BUF_TX_COUNT=8
CONFIG_NET_PKT_RX_COUNT=8
CONFIG_NET_PKT_TX_COUNT=8

CONFIG_NET_MGMT_EVENT_STACK_SIZE=1024
CONFIG_NET_TCP=y
CONFIG_NET_MGMT=y
CONFIG_NET_MGMT_EVENT=y
CONFIG_NET_LOG=y
CONFIG_ENTROPY_GENERATOR=y
CONFIG_TEST_RANDOM_GENERATOR=y

CONFIG_NET_STATISTICS=y
CONFIG_NET_STATISTICS_USER_API=y

# ========== SD Card ===============

CONFIG_DISK_ACCESS=y
CONFIG_DISK_DRIVERS=y
CONFIG_DISK_DRIVER_SDMMC=y

CONFIG_FILE_SYSTEM=y
CONFIG_FAT_FILESYSTEM_ELM=y

CONFIG_SDMMC_STM32_HWFC=y

# Reduzir heap para economizar RAM
CONFIG_COMMON_LIBC_MALLOC_ARENA_SIZE=4096

# ========== SHELL - Reduzido ===============

CONFIG_SHELL=y
CONFIG_I2C_SHELL=y
CONFIG_RTC_SHELL=y
CONFIG_FILE_SYSTEM_SHELL=y
CONFIG_HEAP_MEM_POOL_SIZE=4096
CONFIG_NET_SHELL=y
CONFIG_LV_Z_SHELL=y

# ==== DEBUG - Reduzido =====

CONFIG_DEBUG=y
CONFIG_LOG=y
CONFIG_LOG_MODE_IMMEDIATE=y

# Zephyr RTOS plugin for JlinkGDBserver
CONFIG_DEBUG_THREAD_INFO=y
CONFIG_THREAD_NAME=y
CONFIG_TRACING=y
```

## debug.conf
```kconfig
CONFIG_DEBUG=y

CONFIG_LOG=y
CONFIG_LOG_MODE_IMMEDIATE=y

# Zephyr RTOS plugin for JlinkGDBserver
CONFIG_DEBUG_THREAD_INFO=y
CONFIG_THREAD_NAME=y
CONFIG_TRACING=y
```

## app.overlay
```dts
/ {
	lvgl_pointer {
		compatible = "zephyr,lvgl-pointer-input";
		input = <&ft5446>;
		swap-xy;
	};
};
```

## src/main.c
```c
#include "app_ext_flash.h"
#include "app_sdram.h"
#include "app_version.h"
#include "buzzer_lib.h"
#include "database.h"
#include "eeprom_lib.h"
#include "eth_lib.h"
#include "lcd_lib.h"
#include "leds_lib.h"
#include "rtc_lib.h"
#include "setup_database.h"
#include "slave_modbus.h"
#include <zephyr/kernel.h>

#include "mask_format.h"
#include "sdcard_lib.h"
#include "string_format.h"
#include <stdio.h>
#include <stdlib.h>
#include <string.h>
#include <sys/types.h>

int main(void) {
  char *buf;
  enum leds_lib_channel channel = LED_BLUE;

  k_msleep(1000);

  printk(">> Project: ZPHR-STM32-0003 - v1.0.0<<\r\n");

  rtc_init();
  buzzer_init();
  lcd_init();
  eeprom_lib_init();
  leds_lib_init();
  lcd_bklight_set_percent(50);
  // sdcard_init();

  buf = rtc_format_datetime(NULL);
  printk("Time: %s\n", buf);

  // eeprom_test();
  // buzzer_test(2);
  // lcd_bklight_test(2);
  formatter_test();
  mask_formatter_test();
  sdcard_test();
  sdram_test();
  // ext_mem_test();
  lcd_lvgl_demo();
  eth_init();

  setup_database_init();
  slave_modbus_init();

  // buzzer_ringotne_test();

  uint8_t cnt = 0;
  uint8_t cnt2 = 0;
  char nome[40];
  char nome2[40];
  while (1) {
    cnt2 = cnt++;
    snprintf(nome, sizeof(nome), "valor: %d", cnt2);
    db_acc_set_u8(ACC_LEVEL_FACTORY, GROUP_PROC_VAR, PROC_VAR_MDB_IQC, cnt2);
    db_acc_set_str(ACC_LEVEL_FACTORY, GROUP_SYS_OTA_CONF, PARAM_CNFG_OTA_FILE,
                   nome, sizeof(nome));
    k_msleep(1000);

    cnt2 = 0;
    db_acc_get_u8(ACC_LEVEL_FACTORY, GROUP_PROC_VAR, PROC_VAR_MDB_IQC, &cnt2);
    db_acc_get_str(ACC_LEVEL_FACTORY, GROUP_SYS_OTA_CONF, PARAM_CNFG_OTA_FILE,
                   nome2, sizeof(nome2));
    printk("%s\n", nome2);

    channel = channel >= LED_MAX ? LED_BLUE : channel + 1;
    leds_lib_set(channel, true);

    leds_lib_clear();
  }

  return 0;
}
```

## inc/app_ext_flash.h
```c
#ifndef _APP_EXT_FLASH_H
#define _APP_EXT_FLASH_H

/* C++ detection */
#ifdef __cplusplus
extern "C" {
#endif

int ext_mem_test(void);

/* C++ detection */
#ifdef __cplusplus
}
#endif

#endif  // _APP_EXT_FLASH_H
```

## inc/app_icon.h
```c
#ifndef _APP_ICON_H
#define _APP_ICON_H

/* C++ detection */
#ifdef __cplusplus
extern "C" {
#endif

extern const char nor_hello_msg[];
extern const char nor_glyph_bitmap[];

/* C++ detection */
#ifdef __cplusplus
}
#endif

#endif  // _APP_ICON_H
```

## inc/app_sdram.h
```c
#ifndef _APP_SDRAM_H
#define _APP_SDRAM_H

/* C++ detection */
#ifdef __cplusplus
extern "C" {
#endif

int sdram_test(void);

/* C++ detection */
#ifdef __cplusplus
}
#endif

#endif  // _APP_SDRAM2_H
```

## inc/app_version.h
```c
/*
* Copyright (c) 2022 Circuit Dojo LLC
*
* SPDX-License-Identifier: Apache-2.0
*/

#ifndef _APP_VERSION_H_
#define _APP_VERSION_H_

/* C++ detection */
#ifdef __cplusplus
extern "C"
{
#endif

#include <stdint.h>

enum app_version_build_type
{
  APP_VERSION_BUILD_DEBUG,
  APP_VERSION_BUILD_RELEASE
};

struct app_version
{
  uint32_t major;
  uint32_t minior;
  uint32_t patch;
  uint32_t commit;
  char hash[8];
  char build_date_time[30];
  enum app_version_build_type build_type;
};

// struct app_versioneapp_version_get(void);
void app_version_get(struct app_version *version);

/* C++ detection */
#ifdef __cplusplus
}
#endif

#endif /*_APP_VERSION_H_*/
```

## inc/buzzer_lib.h
```c
#ifndef BUZZER_LIB_H
#define BUZZER_LIB_H

/* C++ detection */
#ifdef __cplusplus
extern "C" {
#endif

int buzzer_init(void);
int buzzer_set_percent(int percent);
int buzzer_test(int test_cycles);
int buzzer_ringotne_test(void);

/* C++ detection */
#ifdef __cplusplus
}
#endif

#endif // BUZZER_LIB_H
```

## inc/eeprom_lib.h
```c
#ifndef _EEPROM_LIB_H
#define _EEPROM_LIB_H

/* C++ detection */
#ifdef __cplusplus
extern "C" {
#endif

#include <stdint.h>
#include <stdio.h>
#include <string.h>

int eeprom_lib_init(void);
int eeprom_lib_write(size_t offset, const void *buf, size_t buflen);
int eeprom_lib_read(size_t offset, void *buf, size_t buflen);
int eeprom_test(void);

/* C++ detection */
#ifdef __cplusplus
}
#endif

#endif /* _EEPROM_LIB_H */
```

## inc/eth_lib.h
```c
#ifndef _ETH_LIB_H
#define _ETH_LIB_H

/* C++ detection */
#ifdef __cplusplus
extern "C" {
#endif

int eth_init(void);

/* C++ detection */
#ifdef __cplusplus
}
#endif

#endif // _ETH_LIB_H
```

## inc/isotp_conn.h
```c
#ifndef ISOTP_CONN_H
#define ISOTP_CONN_H

/* C++ detection */
#ifdef __cplusplus
extern "C" {
#endif

#include <stddef.h>
#include <stdint.h>

#define ISOTP_MAX_DATA_LEN 128
#define ISOTP_NUM_BUFFERS 20

int isotp_conn_init(void);
int isotp_conn_bind(uint32_t rx_addr, uint32_t tx_addr);
void isotp_conn_unbind(void);
int isotp_conn_transmit(uint32_t addr, const uint8_t *data, size_t len);
int isotp_conn_add_message(uint32_t addr, const uint8_t *data, size_t len);
int isotp_conn_process_send(void);
int isotp_conn_receive(uint8_t data[], size_t max_len);

/* C++ detection */
#ifdef __cplusplus
}
#endif

#endif // ISOTP_CONN_H
```

## inc/lcd_lib.h
```c
#ifndef LCD_LIB_H
#define LCD_LIB_H

/* C++ detection */
#ifdef __cplusplus
extern "C" {
#endif

int lcd_init(void);
int lcd_bklight_set_percent(int percent);
int lcd_bklight_test(int test_cycles);
int lcd_lvgl_demo(void);

/* C++ detection */
#ifdef __cplusplus
}
#endif

#endif // LCD_LIB_H
```

## inc/leds_lib.h
```c
#ifndef _LEDS_LIB_H
#define _LEDS_LIB_H

/* C++ detection */
#ifdef __cplusplus
extern "C" {
#endif

#include <stdbool.h>

enum leds_lib_channel {
    LED_BLUE = 0,
    LED_GREEN,
    LED_RED,
    LED_WHITE,
    LED_YELLOW,
    LED_MAX,
};

int leds_lib_init(void);
int leds_lib_set(enum leds_lib_channel led, bool enable);
void leds_lib_clear(void);

/* C++ detection */
#ifdef __cplusplus
}
#endif

#endif /* _LEDS_LIB_H */
```

## inc/rtc_lib.h
```c
#ifndef RTC_LIB
#define RTC_LIB

/* C++ detection */
#ifdef __cplusplus
extern "C" {
#endif

#include <zephyr/device.h>
#include <zephyr/devicetree.h>
#include <zephyr/drivers/rtc.h>
#include <zephyr/kernel.h>
#include <zephyr/sys/timeutil.h>

#define DEFAULT_TD_ISO_8601_TYPE_1 "%Y-%m-%d %H:%M:%S"  // YYYY-MM-DD HH:MM:SS
#define DEFAULT_TD_ISO_8601_TYPE_2 "%d-%m-%Y %H:%M:%S"  // DD-MM-YYYY HH:MM:SS
#define DEFAULT_TD_ISO_8601_TYPE_3 "%H:%M:%S %Y-%m-%d"  // HH:MM:SS YYYY-MM-DD
#define DEFAULT_TD_ISO_8601_TYPE_4 "%H:%M:%S %d-%m-%Y"  // HH:MM:SS DD-MM-YYYY

#define DEFAULT_TD_DD_MM_YYYY_TYPE_1 "%d/%m/%Y %H:%M:%S"  // DD/MM/YYYY HH:MM:SS
#define DEFAULT_TD_YYYY_MM_DD_TYPE_2 "%Y/%m/%d %H:%M:%S"  // YYYY/MM/DD HH:MM:SS
#define DEFAULT_TD_DD_MM_YYYY_TYPE_3 "%H:%M:%S %d/%m/%Y"  // HH:MM:SS DD/MM/YYYY
#define DEFAULT_TD_YYYY_MM_DD_TYPE_4 "%H:%M:%S %Y/%m/%d"  // HH:MM:SS YYYY/MM/DD

#define DEFAULT_TIME_ISO_8601_TYPE_1 "%H:%M:%S"  // HH:MM:SS
#define DEFAULT_TIME_ISO_8601_TYPE_2 "%H:%M"     // HH:MM
#define DEFAULT_DATE_ISO_8601_TYPE_1 "%Y-%m-%d"  // YYYY-MM-DD
#define DEFAULT_DATE_ISO_8601_TYPE_2 "%d-%m-%Y"  // DD-MM-YYYY

#define DEFAULT_DD_MM_YYYY_TYPE_1 "%d/%m/%Y "  // DD/MM/YYYY
#define DEFAULT_YYYY_MM_DD_TYPE_2 "%Y/%m/%d "  // YYYY/MM/DD

typedef union {
  struct {
    uint32_t day : 8;    // 8 bits for day (0-255)
    uint32_t month : 8;  // 8 bits for month (0-255)
    uint32_t year : 16;  // 16 bits for year (0-65535)
  };
  uint32_t value;
} Date_t;

typedef union {
  struct {
    uint32_t second : 8;
    uint32_t minute : 8;
    uint32_t hour : 8;
    uint32_t millisecond : 8;
  };
  uint32_t value;
} Time_t;

Date_t getDate(void);
Time_t getTime(void);

int rtc_init(void);
int rtc_setDay(uint16_t day);
int rtc_setMonth(uint16_t month);
int rtc_setYear(uint16_t year);
int rtc_setHour(uint16_t hour);
int rtc_setMinute(uint16_t minute);
int rtc_setSecond(uint16_t second);

int rtc_set(struct rtc_time rtc_time);
int rtc_get(struct rtc_time *rtc_time);
int rtc_get_timestamp(uint32_t *timestamp);
int rtc_set_timestamp(uint32_t timestamp);
int rtc_convert_timestamp_to_rtctime(uint32_t t, struct rtc_time *rtctime);

char *rtc_format_datetime(const char *format);
char *rtc_format_date(const char *format);
char *rtc_format_time(const char *format);

bool rtc_is_leap_year(uint16_t year);

/* C++ detection */
#ifdef __cplusplus
}
#endif

#endif  // RTC_LIB_H
```

## inc/sdcard_lib.h
```c
#ifndef _SDCARCD_LIB_H
#define _SDCARCD_LIB_H

/* C++ detection */
#ifdef __cplusplus
extern "C" {
#endif

#include <stdbool.h>

int sdcard_init(void);
int sdcard_test(void);

/* C++ detection */
#ifdef __cplusplus
}
#endif

#endif /* _SDCARCD_LIB_H */
```
